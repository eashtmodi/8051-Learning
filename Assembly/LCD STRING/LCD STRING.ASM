ORG 00H;
LOOP:MOV DPTR,#TEXT1;
    MOV A,#0;
	MOV A,#38H;DEFINING 5*7 MATRIX AND 16*2 LCD
	LCALL COMWRT;
	LCALL DELAY;
	MOV A,#0CH;DISPLAY ON AND CURSOR TOO!
	LCALL COMWRT;
	LCALL DELAY;
	MOV A,#1H;LCD CLEAR
	LCALL COMWRT;
	LCALL DELAY;
	MOV A,#80H;CURSOR(0,5);
	LCALL COMWRT;
	LCALL DELAY;
	MOV A,#'M';
	LCALL DATAWRT;
	LCALL DELAY;
	MOV A,#'O';
	LCALL DATAWRT;
	LCALL DELAY;
	MOV A,#'D';
	LCALL DATAWRT;
	LCALL DELAY;
	MOV A,#'I';
	LCALL DATAWRT;
	LCALL DELAY;
	
	MOV A,#0C5H;CURSOR(1,5);
	LCALL COMWRT;
	LCALL DELAY;
	
	
THERE: CLR A;
MOVC A,@A+DPTR;
	LCALL DATAWRT;
	LCALL DELAY;
	JZ LOOP;
	INC DPTR;
    SJMP THERE;
	
HERE: SJMP HERE;

ORG 300H;
COMWRT: MOV P1,A;
	CLR P3.5;
	SETB P3.3;
	LCALL DELAY;
	CLR P3.3;
	RET;
	
ORG 600H;
DATAWRT: MOV P1,A;
	SETB P3.5;
	SETB P3.3;
	LCALL DELAY;
	CLR P3.3;
	RET;
	
ORG 900H;
	DELAY: MOV R0,#255;
	AGAIN: MOV R1,#255;
	HERE2: DJNZ R1,HERE2;
	DJNZ R0,AGAIN;
	RET;

ORG 200H;
TEXT1: DB "MODI",0
	END;
	
	